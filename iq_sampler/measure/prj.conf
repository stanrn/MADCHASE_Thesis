## CMakeLists.txt
```
######################################################################
##        Copyright (c) 2022 Carsten Wulff Software, Norway
## ###################################################################
## Created       : wulff at 2022-5-28
## ###################################################################
##  The MIT License (MIT)
##
##  Permission is hereby granted, free of charge, to any person obtaining a copy
##  of this software and associated documentation files (the "Software"), to deal
##  in the Software without restriction, including without limitation the rights
##  to use, copy, modify, merge, publish, distribute, sublicense, and/or sell
##  copies of the Software, and to permit persons to whom the Software is
##  furnished to do so, subject to the following conditions:
##
##  The above copyright notice and this permission notice shall be included in all
##  copies or substantial portions of the Software.
##
##  THE SOFTWARE IS PROVIDED "AS IS", WITHOUT WARRANTY OF ANY KIND, EXPRESS OR
##  IMPLIED, INCLUDING BUT NOT LIMITED TO THE WARRANTIES OF MERCHANTABILITY,
##  FITNESS FOR A PARTICULAR PURPOSE AND NONINFRINGEMENT. IN NO EVENT SHALL THE
##  AUTHORS OR COPYRIGHT HOLDERS BE LIABLE FOR ANY CLAIM, DAMAGES OR OTHER
##  LIABILITY, WHETHER IN AN ACTION OF CONTRACT, TORT OR OTHERWISE, ARISING FROM,
##  OUT OF OR IN CONNECTION WITH THE SOFTWARE OR THE USE OR OTHER DEALINGS IN THE
##  SOFTWARE.
##
######################################################################


cmake_minimum_required(VERSION 3.20.0)
#add_compile_options(-fno-use-cxa-atexit)


find_package(Zephyr REQUIRED HINTS $ENV{ZEPHYR_BASE})
project(inititator)
#target_link_libraries(app PRIVATE "-fno-use-cxa-atexit" "-fno-rtti")
#set(CONFIG_CPLUSPLUS "n" CACHE STRING "Disable C++")
#set(CMAKE_CXX_FLAGS "-fno-exceptions")


# Disable C++ usage
#set(CMAKE_CXX_STANDARD 98)  # Ensure C++ is not used
#set(CMAKE_CXX_COMPILER "")

target_sources(app PRIVATE   src/main.c)
```

## prj.conf
```kconfig
CONFIG_SERIAL=y
CONFIG_GPIO=y
CONFIG_NRF_DM=y
CONFIG_NEWLIB_LIBC=y
CONFIG_NEWLIB_LIBC_FLOAT_PRINTF=y
CONFIG_DEBUG_INFO=y
CONFIG_PINCTRL=y
CONFIG_NRFX_SPIS0=y
CONFIG_NRFX_UARTE0=y
CONFIG_MAIN_STACK_SIZE=4096
```

## src/main.c
```c
/*********************************************************************
 *        Copyright (c) 2022 Carsten Wulff Software, Norway
 * *******************************************************************
 * Created       : wulff at 2022-5-28
 * *******************************************************************
 *  The MIT License (MIT)
 *
 *  Permission is hereby granted, free of charge, to any person obtaining a copy
 *  of this software and associated documentation files (the "Software"), to deal
 *  in the Software without restriction, including without limitation the rights
 *  to use, copy, modify, merge, publish, distribute, sublicense, and/or sell
 *  copies of the Software, and to permit persons to whom the Software is
 *  furnished to do so, subject to the following conditions:
 *
 *  The above copyright notice and this permission notice shall be included in all
 *  copies or substantial portions of the Software.
 *
 *  THE SOFTWARE IS PROVIDED "AS IS", WITHOUT WARRANTY OF ANY KIND, EXPRESS OR
 *  IMPLIED, INCLUDING BUT NOT LIMITED TO THE WARRANTIES OF MERCHANTABILITY,
 *  FITNESS FOR A PARTICULAR PURPOSE AND NONINFRINGEMENT. IN NO EVENT SHALL THE
 *  AUTHORS OR COPYRIGHT HOLDERS BE LIABLE FOR ANY CLAIM, DAMAGES OR OTHER
 *  LIABILITY, WHETHER IN AN ACTION OF CONTRACT, TORT OR OTHERWISE, ARISING FROM,
 *  OUT OF OR IN CONNECTION WITH THE SOFTWARE OR THE USE OR OTHER DEALINGS IN THE
 *  SOFTWARE.
 *
 ********************************************************************/


//#include <zephyr.h>
//#include <init.h>
#include <nrf.h>
#include <nrfx.h>
#include "nrf_dm.h"
#include "nrfx_config.h"
#include "nrfx_clock.h"
#include "nrfx_uarte.h"
#include "nrfx_spis.h"
#include <stdint.h>
#include <stdbool.h>
#include <stdlib.h>
#include <stdio.h>

// UART PIN config
#ifndef TXD_PIN
#define TXD_PIN 6
#endif

#ifndef RXD_PIN
#define RXD_PIN 8
#endif

// SPI PIN config
#ifndef SS_PIN
#define SS_PIN 12
#endif

#ifndef SCK_PIN
#define SCK_PIN 16
#endif

#ifndef MOSI_PIN
#define MOSI_PIN 14
#endif

#ifndef MISO_PIN
#define MISO_PIN 15
#endif

#include "dm.c"
#include "uart.c"
#include "roles.c"

// Setting config and report variables for distance measurements
static nrf_dm_config_t dm_config;
static nrf_dm_report_t dm_report;

#ifdef __cplusplus
extern "C" {
#endif

void *__dso_handle = 0;

#ifdef __cplusplus
}
#endif

// None of the SPI code is currently implemented
int main(void)
{
  //Initialization
  dm_clock_init();
  debug_init();
  dm_init();

  int current_role = CMD_NONE;
  /*spi_init();
  manual_isr_setup();
  set_spi_buffer();*/
  // Getting first roles
  MeasPair result = read_uart_role();
  current_role = result.role;
  int seed = result.seed + 40;
  // While loop for dynamic role changing
  while(1){
    if (current_role == CMD_INITIATOR){
      result = run_initiator(seed);
      current_role = result.role;
      seed = result.seed + 40;
    } else if (current_role == CMD_REFLECTOR){
      result = run_reflector(seed);
      current_role = result.role;
      seed = result.seed + 40;
    } else if (current_role == CMD_NONE){
      result = run_none(seed);
      current_role = result.role;
      seed = result.seed + 40;
    }
  }
    // Unreachable in normal code
    //spi_uninit();
    return 0;
}
```

## src/dm.c
```c
/*********************************************************************
 *        Copyright (c) 2022 Carsten Wulff Software, Norway
 * *******************************************************************
 * Created       : wulff at 2022-5-28
 * *******************************************************************
 *  The MIT License (MIT)
 *
 *  Permission is hereby granted, free of charge, to any person obtaining a copy
 *  of this software and associated documentation files (the "Software"), to deal
 *  in the Software without restriction, including without limitation the rights
 *  to use, copy, modify, merge, publish, distribute, sublicense, and/or sell
 *  copies of the Software, and to permit persons to whom the Software is
 *  furnished to do so, subject to the following conditions:
 *
 *  The above copyright notice and this permission notice shall be included in all
 *  copies or substantial portions of the Software.
 *
 *  THE SOFTWARE IS PROVIDED "AS IS", WITHOUT WARRANTY OF ANY KIND, EXPRESS OR
 *  IMPLIED, INCLUDING BUT NOT LIMITED TO THE WARRANTIES OF MERCHANTABILITY,
 *  FITNESS FOR A PARTICULAR PURPOSE AND NONINFRINGEMENT. IN NO EVENT SHALL THE
 *  AUTHORS OR COPYRIGHT HOLDERS BE LIABLE FOR ANY CLAIM, DAMAGES OR OTHER
 *  LIABILITY, WHETHER IN AN ACTION OF CONTRACT, TORT OR OTHERWISE, ARISING FROM,
 *  OUT OF OR IN CONNECTION WITH THE SOFTWARE OR THE USE OR OTHER DEALINGS IN THE
 *  SOFTWARE.
 *
 ********************************************************************/








#define DBGPIN_1  30
#define DBGPIN_2  31

void debug_init(){

  // Configure GPIO pin as output with standard drive strength.
  NRF_GPIO->PIN_CNF[DBGPIN_2] =
    (GPIO_PIN_CNF_DIR_Output << GPIO_PIN_CNF_DIR_Pos) | (GPIO_PIN_CNF_DRIVE_S0S1 << GPIO_PIN_CNF_DRIVE_Pos)
    | (GPIO_PIN_CNF_INPUT_Connect << GPIO_PIN_CNF_INPUT_Pos) | (GPIO_PIN_CNF_PULL_Disabled << GPIO_PIN_CNF_PULL_Pos)
    | (GPIO_PIN_CNF_SENSE_Disabled << GPIO_PIN_CNF_SENSE_Pos);

  // Configure GPIO pin as output with standard drive strength.
  NRF_GPIO->PIN_CNF[DBGPIN_1] =
    (GPIO_PIN_CNF_DIR_Output << GPIO_PIN_CNF_DIR_Pos) | (GPIO_PIN_CNF_DRIVE_S0S1 << GPIO_PIN_CNF_DRIVE_Pos)
    | (GPIO_PIN_CNF_INPUT_Connect << GPIO_PIN_CNF_INPUT_Pos) | (GPIO_PIN_CNF_PULL_Disabled << GPIO_PIN_CNF_PULL_Pos)
      | (GPIO_PIN_CNF_SENSE_Disabled << GPIO_PIN_CNF_SENSE_Pos);


  //NRF_GPIOTE->CONFIG[0] = GPIOTE_CONFIG_MODE_Task | (DBGPIN_2 << GPIOTE_CONFIG_PSEL_Pos)
  //                        | (GPIOTE_CONFIG_POLARITY_Toggle << GPIOTE_CONFIG_POLARITY_Pos)
  //    | (GPIOTE_CONFIG_OUTINIT_High << GPIOTE_CONFIG_OUTINIT_Pos);

  //NRF_PPI->FORK[0].TEP = (uint32_t)&NRF_GPIOTE->TASKS_OUT[0];

}

static void debug_set(uint32_t pin)
{

  NRF_GPIO->OUTSET = 0x1 << pin;

}

static void debug_clear(uint32_t pin)
{

  NRF_GPIO->OUTCLR = 0x1 << pin;

}

void debug_start(){
    debug_set(DBGPIN_2);
}

void debug_stop(){
    debug_clear(DBGPIN_2);
}


void dm_init(){
    //- Setup Nordic Distance Toolbox

  uint8_t ppi_ch[2] = {0,1};
  nrf_dm_ppi_config_t ppi_conf = {
  .ppi_chan_count = 2,
  .ppi_chan = &ppi_ch[0],
};

  nrf_dm_antenna_config_t ant_cfg = NRF_DM_DEFAULT_SINGLE_ANTENNA_CONFIG ;
  nrf_dm_init(&ppi_conf,&ant_cfg,NRF_TIMER1);
}


void debug_pulse(int delay){
  debug_set(DBGPIN_1);
  volatile int z = 0;
   for(int i=0;i<delay;i++){ z+= 1;}

  debug_clear(DBGPIN_1);
}


static void m_nrfx_clock_event_handler(nrfx_clock_evt_type_t event)
{
  (void) event;
}

void dm_clock_init(void)
{
#ifdef NRF_CLOCK_NS
  #define NRF_CLOCK NRF_CLOCK_NS
#endif

  nrfx_clock_init(m_nrfx_clock_event_handler);
  nrfx_clock_start(NRF_CLOCK_DOMAIN_HFCLK);

  while(true)
  {
    nrf_clock_hfclk_t src;
    if(nrfx_clock_is_running(NRF_CLOCK_DOMAIN_HFCLK, &src) && (src == NRF_CLOCK_HFCLK_HIGH_ACCURACY))
    {
      break;
    }
  }
}
```

## src/roles.c
```c
enum Role {
    CMD_INITIATOR,
    CMD_REFLECTOR,
    CMD_NONE,
    CMD_UNKNOWN = -1
};

typedef struct {
    int role;
    int seed;
} MeasPair;

MeasPair read_uart_role(void){
    uart_init();
    //SPI code not implemented!!
    /*spi_get_buffer();
    uart_put_string("XDit gebeurt");
    if(test_spi() && set_spi_buffer() == 1){
        uart_put_string("SPI INIT AND BUF");
    }
    else if(test_spi()){
        uart_put_string("SPI INIT");
    }
    else{
        uart_put_string("SPI UNINIT");
    }*/
    // Reading the role and seed value from UART, changing role and returning it
    char buf[16]; // Max 1 role + 2 digits seed (e.g., r99) + null
    MeasPair result = { .role = CMD_UNKNOWN, .seed = -1 };
    if (uart_chars_available()){
        uart_get_string(buf, sizeof(buf));
        size_t len = strlen(buf);
        if (len >= 2) {
            if (buf[0] == 'i') {
                result.role = CMD_INITIATOR;
                uart_put_string("Werkt dit?{i_local:[0,0,0,0,3360,608,-5120,3584,-1024,-3200,-160,2080,-320,-160,320,96,-1184,-1952,2624,-3488,2528,-224,1280,4288,3424,1312,-2368,-4256,1024,3168,1472,-1984,-2304,3584,-3040,2528,3648,-2816,-928,-192,-1824,-1216,-2272,-2592,-1632,-2048,1376,-480,2176,-1984,-1120,0,-1856,-1856,-1888,-928,-1920,544,2016,-1376,480,1632,-2176,2368,2592,-2560,-2912,2944,3104,1632,-2176,-3168,-2624,-2528,3296,-352,2400,-672,800,0],q_local:[0,0,0,0,4864,5568,1024,3104,4192,1504,-2880,-160,1312,864,-896,-544,1408,-1504,1408,0,2944,4160,4128,-1088,2848,4320,3776,864,-4128,-2624,-4000,3552,-3232,1856,2336,-2880,800,-2272,3328,3328,-2624,-2816,1792,608,1856,-864,-1632,-2240,96,576,1696,1920,-224,512,-256,-1696,192,-1888,672,-1824,2304,1760,-1472,1312,928,-1216,992,1120,192,-2816,-2336,384,-1920,2112,-160,3168,-2112,3072,-2944,0],i_remote:[0,0,0,0,-1184,3104,3424,2080,3968,480,-2496,1472,768,960,-736,960,608,2272,-2656,3488,-288,3840,4032,-1024,3936,4672,704,-3808,128,3712,2400,-3680,128,224,-3680,3392,-3136,3936,-1696,-1376,2560,608,3296,1952,2848,-1824,-576,-1952,2496,-2464,-2336,-2080,192,320,1856,1824,2304,-1312,-1504,-1152,2720,2496,-2560,3136,3328,-3328,-3584,2688,2560,2848,2944,-160,3392,-192,-3168,-1088,-2528,1216,-2144,0],q_remote:[0,0,0,0,5760,4640,-3648,4064,-960,-3552,1504,1600,-1184,-320,-704,-928,1792,-1088,1600,-928,4064,2272,2272,4608,2688,-1440,-4864,-2912,4608,2688,3808,-2656,4352,-4256,2272,-2560,-5600,1472,3552,3584,-2816,-3424,640,-1568,-1376,-2496,1824,1792,352,-288,-672,-1056,2304,2272,1344,-1504,128,-1984,2048,-2528,1056,1664,-1760,864,544,960,-736,-2656,-2912,-64,1376,3904,2112,4032,-2464,3744,-2944,3680,-3200,0],hopping_sequence:[63,53,77,32,66,6,41,25,38,60,74,42,4,21,7,52,69,35,13,44,16,23,39,37,58,76,48,57,17,36,9,49,45,12,24,10,55,14,29,31,34,50,61,26,15,72,20,40,19,46,8,5,70,59,51,75,43,64,33,27,68,47,78,62,18,71,30,28,73,54,56,67,65,22,11],sinr_local:[0,0,0,0,0,0,0,0,0,0,0,0,0,1,0,2,0,0,0,0,0,0,0,0,0,0,0,0,0,0,0,0,0,0,0,0,2,2,0,0,0,0,0,0,0,1,0,0,0,0,0,0,0,0,0,0,0,0,0,0,0,0,0,0,0,0,0,0,0,0,0,0,0,0,0,0,0,0,0,0],sinr_remote:[0,0,0,0,0,0,0,0,0,0,0,0,0,0,0,0,0,0,0,0,0,0,0,0,0,0,0,0,0,0,0,2,0,0,0,0,2,2,0,0,0,0,0,0,0,0,2,0,0,0,0,0,0,0,0,0,0,0,0,0,0,0,0,0,0,0,0,0,0,2,2,0,0,0,0,0,0,0,0,0],ifft[mm] : 1578,phase_slope[mm] : 6833,rssi_openspace[mm] : 7943,best[mm] : 1578,highprec[mm] : 0,link_loss[dB] : 58,duration[us] : 20087,rssi_local[dB] : 51,rssi_remote[dB] : 49,txpwr_local[dB] : 8,txpwr_remote[dB] : 8,quality : 0}\n)");
            } else if (buf[0] == 'r') {
                result.role =  CMD_REFLECTOR;
            } else if (buf[0] == 'n') {
                result.role = CMD_NONE;
            } else {
                result.role = CMD_UNKNOWN;
            }       
            result.seed = atoi(&buf[1]);  // rest is the number
        }
    }
    uart_uninit();
    return result;  // No new input
}

MeasPair run_initiator(int seed){

    static nrf_dm_config_t dm_config;
    static nrf_dm_report_t dm_report;

    dm_config = NRF_DM_DEFAULT_CONFIG;
    dm_config.role = NRF_DM_ROLE_INITIATOR;
    dm_config.rng_seed = seed;

    while(1){
        // Clear previous result
        dm_report.link_loss = 0;
        dm_report.rssi_local = 0;
        dm_report.rssi_remote = 0;
        dm_report.txpwr_local = 0;
        dm_report.txpwr_remote = 0;
        dm_report.quality = 90;
        dm_report.distance_estimates.mcpd.ifft = 0;
        dm_report.distance_estimates.mcpd.phase_slope = 0;
        dm_report.distance_estimates.mcpd.rssi_openspace = 0;
        dm_report.distance_estimates.mcpd.best = 0;
        for(int i=0;i<80;i++){
        dm_report.iq_tones->i_local[i] =0;
        dm_report.iq_tones->q_local[i] =0;
        dm_report.iq_tones->i_remote[i] =0;
        dm_report.iq_tones->q_remote[i] =0;
        }
        for(int i=0;i<80;i++){
        dm_report.tone_sinr_indicators.sinr_indicator_local[i] =0;
        dm_report.tone_sinr_indicators.sinr_indicator_remote[i] =0;
        }

        // Execute measurement
        nrf_dm_status_t status = nrf_dm_configure(&dm_config);
        debug_start();
        uint32_t timeout_us = 0.5e6;
        status     = nrf_dm_proc_execute(timeout_us);
        debug_stop();

        float distance = 0;
        uint32_t duration = 0;
        uint8_t hopping_sequence[NRF_DM_CHANNEL_MAP_LEN];

        if(status == NRF_DM_STATUS_SUCCESS){
            nrf_dm_populate_report(&dm_report);
            nrf_dm_quality_t quality = nrf_dm_calc(&dm_report);
            duration = nrf_dm_get_duration_us(&dm_config);
            distance = nrf_dm_high_precision_calc(&dm_report);
            nrf_dm_get_hopping_sequence(&dm_config,hopping_sequence);

        } else{  // Failure
       
        dm_report.quality = 100;
        debug_pulse(10);
        }

        //Send report to UART
        uart_init();
        nrf_dm_report_to_json(&dm_report,distance,duration,hopping_sequence);
        uart_uninit();


        // Check for role change after each execution
        MeasPair new_result = read_uart_role();
        int new_role = new_result.role;
        int new_seed = new_result.seed;
        if (new_role != CMD_UNKNOWN) {
            return new_result; 
        }
    }
}


MeasPair run_reflector(int seed){
    static nrf_dm_config_t dm_config;

    dm_config = NRF_DM_DEFAULT_CONFIG;
    dm_config.role = NRF_DM_ROLE_REFLECTOR;
    dm_config.rng_seed = seed;


    while(1){
        nrf_dm_status_t status = nrf_dm_configure(&dm_config);
        debug_start();
        uint32_t timeout_us = 3e6;
        status = nrf_dm_proc_execute(timeout_us);
        debug_stop();

        if (status == NRF_DM_STATUS_SUCCESS){
            debug_pulse(10);
        } else {
            debug_pulse(5);
        }

        // Check for role change after each execution
        MeasPair new_result = read_uart_role();
        int new_role = new_result.role;
        int new_seed = new_result.seed;
        if (new_role != CMD_UNKNOWN) {
            return new_result; 
        }
    }
}

MeasPair run_none(int seed){
    static nrf_dm_config_t dm_config;

    dm_config = NRF_DM_DEFAULT_CONFIG;
    dm_config.role = NRF_DM_ROLE_REFLECTOR;
    dm_config.rng_seed = seed;

    nrf_dm_status_t status = nrf_dm_configure(&dm_config);
    while(1){
        // Check for role change after each execution
        MeasPair new_result = read_uart_role();
        int new_role = new_result.role;
        int new_seed = new_result.seed;
        if (new_role != CMD_UNKNOWN) {
            return new_result; 
        }
    }

}
```

## src/uart.c
```c
//------------------------------------------------------------------
// Setup UARTE to PC
//------------------------------------------------------------------

#define SPI_BUFFER_SIZE 10
static nrfx_uarte_t instance = NRFX_UARTE_INSTANCE(0);
static nrfx_spis_t instance_spi = NRFX_SPIS_INSTANCE(0); // SPI instance

//SPI Buffers
static uint8_t rx_buffer[SPI_BUFFER_SIZE];
static uint8_t tx_buffer[SPI_BUFFER_SIZE];
volatile bool transfer_done = false; //Bool to indicate SPI transfer done
volatile bool first = true; //Bool to indicate SPI transfer done

void uart_put_char(uint8_t ch);
void uart_put_string(const char * string);

void uart_init(void){
    nrfx_uarte_config_t config = NRFX_UARTE_DEFAULT_CONFIG(TXD_PIN, RXD_PIN);
    config.baudrate            = NRF_UARTE_BAUDRATE_115200;
    nrfx_err_t err = nrfx_uarte_init(&instance, &config, NULL);
}

void uart_uninit(void){
    nrfx_uarte_uninit(&instance);
}

// SPI event handler
void spis_event_handler(nrfx_spis_evt_t const *p_event, void *p_context) {
    if (p_event->evt_type == NRFX_SPIS_XFER_DONE) {
        transfer_done = true;
        uart_put_string("SPI XFER DONE\n");
        char msg[64];
        snprintf(msg, sizeof(msg), "SPI XFER DONE, RX: %d, TX: %d\n",
                 (int)p_event->rx_amount, (int)p_event->tx_amount);
        uart_put_string(msg);
        char buf[10];
        for (int i = 0; i < p_event->rx_amount; i++) {
        snprintf(buf, sizeof(buf), "%02X ", rx_buffer[i]);
        uart_put_string(buf);
}
    }
    else if(p_event->evt_type == NRFX_SPIS_BUFFERS_SET_DONE) {
      uart_put_string("BUFFER SET DONE\n");
    }
}
//SPI Initialization
void spi_init(void){
  nrfx_spis_config_t spi_config = NRFX_SPIS_DEFAULT_CONFIG(SCK_PIN,MOSI_PIN,MISO_PIN,SS_PIN);
    spi_config.mode = NRF_SPIS_MODE_0;
    spi_config.bit_order = NRF_SPIS_BIT_ORDER_MSB_FIRST;

    nrfx_err_t err = nrfx_spis_init(&instance_spi, &spi_config, spis_event_handler, NULL);
    if (err != NRFX_SUCCESS) {
    uart_put_string("SPI init failed!\n");
  }
}

void spi_uninit(void){
  nrfx_spis_uninit(&instance_spi);
}
// Setting interrupts manually
static void manual_isr_setup()
{
	IRQ_DIRECT_CONNECT(SPIM0_SPIS0_TWIM0_TWIS0_SPI0_TWI0_IRQn, 0, nrfx_spis_0_irq_handler, 0);
	irq_enable(SPIM0_SPIS0_TWIM0_TWIS0_SPI0_TWI0_IRQn);
}
//Testing correct initialization of SPI
int test_spi(void){
  if(!nrfx_spis_init_check(&instance_spi)){
    return 0;
  }
  return 1;
}

//Read value of the chip select pin, if low SPI is being communicated
bool read_cs_state_raw(void) {
    return (NRF_P0->IN & (1 << 12)) != 0;  // true = HOOG, false = LAAG
}
//Empty the buffers for SPI communication
int set_spi_buffer(void){
  memset(rx_buffer, 0, SPI_BUFFER_SIZE);
  transfer_done = false;
  /*if(!read_cs_state_raw()){
    return 1;
  }
  if(transfer_done){
    return 1;
  }*/
  uart_put_string("YDit gebeurt");
  nrfx_err_t err = nrfx_spis_buffers_set(&instance_spi, rx_buffer, SPI_BUFFER_SIZE, tx_buffer, SPI_BUFFER_SIZE);
  if(err == NRFX_SUCCESS){
    uart_put_string("Dit gebeurt?");
    return 1;
  }
  else{
    return 0;
  }

}
//Test: delete later
void fake_measurement_and_json(char *json_out, size_t max_len) {
    float distance = 123.45f;
    const char *unit = "cm";

    // Bouw de JSON-string zelf
    snprintf(json_out, max_len, "{\"distance\":%.2f,\"unit\":\"%s\"}", distance, unit);
}
// Read from the SPI buffer
void spi_get_buffer(void){
  if(read_cs_state_raw()){
    uart_put_string("CS hoog");
  }
  while(!transfer_done && !first);
  first = false;
  char buf[10];
  for (int i = 0; i <10; i++) {
      snprintf(buf, sizeof(buf), "%02X ", rx_buffer[i]);
      uart_put_string(buf);}
  if (strncmp((char *)rx_buffer, "START", 5) == 0) {
    uart_put_string("JA");
    memset(tx_buffer, 0, SPI_BUFFER_SIZE);
    fake_measurement_and_json((char *)tx_buffer, SPI_BUFFER_SIZE);
  }
  else{
    uart_put_string("Ontvangen: ");
    char buf[10];
    for (int i = 9; i > 0; i--) {
        snprintf(buf, sizeof(buf), "%02X ", rx_buffer[i]);
        uart_put_string(buf);}
    uart_put_string("NEE");
  }
}

// Sending string over UART
void uart_put_string(const char * string)
{
  while (*string != '\0')
  {
    uart_put_char(*string++);
  }
}

int uart_cbprint(int ch, void * ctx){
  nrfx_uarte_tx(&instance, &ch, 1, 0);
}

void uart_put_char(uint8_t ch)
{
  nrfx_uarte_tx(&instance, &ch, 1, 0);
}

bool uart_chars_available(void)
{
  return nrfx_uarte_rx_ready(&instance, NULL);
}

void uart_get_char(uint8_t * p_ch)
{
  nrfx_uarte_errorsrc_get(&instance);
  nrfx_uarte_rx(&instance, p_ch, 1);
}

void uart_get_string(char *buf, size_t max_len) {
    if (max_len < 4) return;  // 3 + null terminator
    nrfx_err_t err = nrfx_uarte_rx(&instance, (uint8_t *)buf, 3);
    if (err != NRFX_SUCCESS) {
      uart_put_string("RX error\n");
      return;
    }

    buf[3] = '\0';
}

void dist_to_json(char *str, float f){

  int d = ((int)1000*f);
  cbprintf(&uart_cbprint, 0, "\"%s\" : %d",str, d);
}

void int_to_json(char *str, int d){
  cbprintf(&uart_cbprint, 0, "\"%s\" : %d",str, d);
}

void tones_to_json(char * str, float *array,uint32_t length){

  uart_put_string("\"");
  uart_put_string(str);
  uart_put_string("\":[");
  for (uint32_t i = 0; i < length; i++)
  {
    //- Assume 10-bit ADC, and scale resolution to 15-bit, should be more than enough precision
    int f = ((int)32*array[i]);
    cbprintf(&uart_cbprint, 0, "%d", f);

    if ((i + 1) < length)
    {
      uart_put_string(",");
    }
  }
  uart_put_string("]");
}

void uint8array_to_json(char * str, uint8_t *array,uint32_t length){

  uart_put_string("\"");
  uart_put_string(str);
  uart_put_string("\":[");
  for (uint32_t i = 0; i < length; i++)
  {

    cbprintf(&uart_cbprint, 0, "%u", array[i]);

    if ((i + 1) < length)
    {
      uart_put_string(",");
    }
  }
  uart_put_string("]");
}

void sinr_to_json(char * str, nrf_dm_sinr_indicator_t *array,uint32_t length){

  uart_put_string("\"");
  uart_put_string(str);
  uart_put_string("\":[");
  for (uint32_t i = 0; i < length; i++)
  {

    cbprintf(&uart_cbprint, 0, "%d", ((int)array[i]));

    if ((i + 1) < length)
    {
      uart_put_string(",");
    }
  }
  uart_put_string("]");
}

void nrf_dm_report_to_json(nrf_dm_report_t *dm_report,float distance,int32_t duration, uint8_t *hopping_sequence){
  uart_put_string("{");

  //- Print tones

  tones_to_json("i_local",&dm_report->iq_tones->i_local[0],80); uart_put_string(",");
  tones_to_json("q_local",&dm_report->iq_tones->q_local[0],80); uart_put_string(",");
  tones_to_json("i_remote",&dm_report->iq_tones->i_remote[0],80); uart_put_string(",");
  tones_to_json("q_remote",&dm_report->iq_tones->q_remote[0],80); uart_put_string(",");
  uint8array_to_json("hopping_sequence",hopping_sequence,NRF_DM_CHANNEL_MAP_LEN); uart_put_string(",");


  //- Print tone_sinr
  sinr_to_json("sinr_local",&dm_report->tone_sinr_indicators.sinr_indicator_local[0],80); uart_put_string(",");
  sinr_to_json("sinr_remote",&dm_report->tone_sinr_indicators.sinr_indicator_remote[0],80); uart_put_string(",");

  //- Print ranging mode
  //- Print distance
  dist_to_json("ifft[mm]",dm_report->distance_estimates.mcpd.ifft);uart_put_char(',');
  dist_to_json("phase_slope[mm]",dm_report->distance_estimates.mcpd.phase_slope);uart_put_char(',');
  dist_to_json("rssi_openspace[mm]",dm_report->distance_estimates.mcpd.rssi_openspace);uart_put_char(',');
  dist_to_json("best[mm]",dm_report->distance_estimates.mcpd.best);uart_put_char(',');
  dist_to_json("highprec[mm]",distance);uart_put_char(',');

  //- Status params
  int_to_json("link_loss[dB]",dm_report->link_loss); uart_put_char(',');
  int_to_json("duration[us]",duration); uart_put_char(',');
  int_to_json("rssi_local[dB]",dm_report->rssi_local); uart_put_char(',');
  int_to_json("rssi_remote[dB]",dm_report->rssi_remote); uart_put_char(',');
  int_to_json("txpwr_local[dB]",dm_report->txpwr_local); uart_put_char(',');
  int_to_json("txpwr_remote[dB]",dm_report->txpwr_remote); uart_put_char(',');
  int_to_json("quality",dm_report->quality);
  uart_put_string("}\n");
}
```
